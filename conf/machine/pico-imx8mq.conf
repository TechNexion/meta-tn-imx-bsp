## conf/machine/pico-imx8mq.conf
```bitbake
#@TYPE: Machine
#@NAME: PICO-IMX8M
#@SOC: i.MX8MQ
#@DESCRIPTION: Machine configuration for PICO-IMX8M
#@MAINTAINER: Richard Hu <richard.hu@technexion.com>

MACHINEOVERRIDES =. "mx8:mx8m:mx8mq:"

require conf/machine/include/imx-base.inc
require conf/machine/include/arm/arch-arm64.inc

#BBMASK += "meta-fsl-bsp-release/imx/meta-bsp/classes/image_types_fsl.bbclass"

MACHINE_FEATURES += " pci wifi bluetooth"

MACHINE_SOCARCH_FILTER_append_mx8mq = "virtual/libopenvg virtual/libgles1 virtual/libgles2 virtual/egl virtual/mesa virtual/libgl virtual/libg2d"

PREFERRED_PROVIDER_virtual/kernel ?= "linux-tn-imx"
PREFERRED_PROVIDER_virtual/kernel_mx8mq = "linux-tn-imx"

# Add kernel modules
MACHINE_EXTRA_RRECOMMENDS += "\
    kernel-module-qcacld-tn \
"

KERNEL_DEVICETREE ?= "freescale/imx8mq-pico-pi.dtb"

#IMAGE_M4LOADER = "imx-m4-demos"
#IMAGE_M4 = "imx8mq_m4_TCM_hello_world.bin imx8mq_m4_TCM_rpmsg_lite_pingpong_rtos_linux_remote.bin imx8mq_m4_TCM_rpmsg_lite_str_echo_rtos.bin"

PREFERRED_PROVIDER_u-boot = "u-boot-edm"
PREFERRED_PROVIDER_u-boot_mx8mq = "u-boot-edm"
PREFERRED_PROVIDER_virtual/bootloader = "u-boot-edm"
PREFERRED_PROVIDER_virtual/bootloader_mx8mq = "u-boot-edm"

UBOOT_CONFIG ??= "sd"
UBOOT_CONFIG[sd] = "pico-imx8m_defconfig,sdcard"
UBOOT_CONFIG[mfgtool] = "pico-imx8m_defconfig"
SPL_BINARY = "spl/u-boot-spl.bin"

# Ensure uEnv.txt will be available at rootfs time
#do_rootfs[depends] += "u-boot-uenv:do_deploy"

#UENV_FILENAME = "uEnv.txt"
#BOOT_SCRIPTS = "${UENV_FILENAME}:uEnv.txt"

# Set DDR FIRMWARE
DDR_FIRMWARE_NAME = "lpddr4_pmu_train_1d_imem.bin lpddr4_pmu_train_1d_dmem.bin lpddr4_pmu_train_2d_imem.bin lpddr4_pmu_train_2d_dmem.bin"

# Set u-boot DTB
UBOOT_DTB_NAME = "pico-imx8m.dtb"

# Set imx-mkimage boot target
IMXBOOT_TARGETS = "flash_evk flash_evk_no_hdmi"

# Set Serial console
SERIAL_CONSOLE = "115200 ttymxc0"

IMAGE_BOOTLOADER = "imx-boot"

BOOT_SPACE = "65536"

LOADADDR = ""
UBOOT_SUFFIX = "bin"
UBOOT_MAKE_TARGET = ""
IMX_BOOT_SEEK = "33"

MACHINE_EXTRA_RRECOMMENDS += " \
  openssh-sftp-server \
  libsocketcan \
  bash hostapd dnsmasq haveged create-ap iptables \
"

MACHINE_FIRMWARE_remove = "linux-firmware-ath10k firmware-imx-brcm"

# to restrict building to sdcard.bz2 ext4 and tar.xz and using the override image_types_fsl_tn
#IMAGE_FSTYPES += "tar.xz ext4 sdcard.bz2"
#IMAGE_FSTYPES_remove = "wic wic.bmap"
#IMAGE_CLASSES += "image_types_fsl_tn"
#IMAGE_CLASSES_remove = "image_types_fsl"
```

## conf/machine/pico-imx91.conf
```bitbake
#@TYPE: Machine
#@NAME: TechNexion PICO-IMX91
#@SOC: i.MX91
#@DESCRIPTION: Machine configuration for TechNexion PICO-IMX91
#@MAINTAINER: William Tsao <william.tsao@technexion.com>

MACHINEOVERRIDES =. "mx91:"

require conf/machine/include/imx91-evk.inc
require conf/machine/tn-base.inc

# Kernel specifics
KERNEL_DEVICETREE = " \
		freescale/imx91-pico-sk.dtb \
		freescale/overlays/imx91-pico-sk-vxt-vl050-070-8048nt.dtbo \
		freescale/overlays/imx91-pico-sk-vxt-vl0808060nt.dtbo \
"
EXTRA_OEMAKE:append:pn-linux-tn-imx = " DTC_FLAGS='-@ -H epapr'"
SWU_DEFAULT_KERNEL_DEVICETREE = "imx91-pico-sk.dtb"

# U-boot specifics
UBOOT_CONFIG = "sd"
UBOOT_CONFIG[sd] = "pico-imx91_defconfig,sdcard"
UBOOT_CONFIG[mfgtool] = "pico-imx91_defconfig"
UBOOT_DTB_NAME = "imx91-pico.dtb"

# Set ATF platform name
ATF_PLATFORM = "imx91"
IMXBOOT_TARGETS = "flash_singleboot"
IMX_BOOT_SOC_TARGET = "iMX91"
IMX_BOOT_SEEK:pico-imx91 = "32"

# Set Serial console
SERIAL_CONSOLES = "115200;ttyLP0"
SERIAL_BLUETOOTH = "3000000;ttyLP4"

DDR_FIRMWARE_NAME = " \
    lpddr4_dmem_1d_v202201.bin \
    lpddr4_dmem_2d_v202201.bin \
    lpddr4_imem_1d_v202201.bin \
    lpddr4_imem_2d_v202201.bin \
"
IMX_DEFAULT_BOOTLOADER:use-nxp-bsp = "u-boot-imx"
IMX_DEFAULT_BOOTLOADER:use-mainline-bsp = "u-boot-fslc"

# WIC Image
WIC_FSTAB_BLKDEV = "mmcblk0"
WIC_PARTITION_TABLE_TYPE ?= "msdos"
```

## conf/machine/picosom-dwarf-imx6.conf
```bitbake
#@TYPE: Machine
#@NAME: PicoSOM Dwarf i.mx6
#@SOC: i.MX6
#@DESCRIPTION: Machine configuration for PicoSOM Dwarf i.mx6

include conf/machine/include/imx-base.inc
include conf/machine/include/tune-cortexa9.inc

SOC_FAMILY = "mx6:mx6dl:mx6q"

PREFERRED_PROVIDER_u-boot = "u-boot-edm"
PREFERRED_PROVIDER_virtual/bootloader = "u-boot-edm"
PREFERRED_PROVIDER_u-boot_mx6 = "u-boot-edm"
UBOOT_MAKE_TARGET = ""
UBOOT_SUFFIX = "img"
SPL_BINARY = "SPL"
UBOOT_MACHINE = "picosom-imx6_defconfig"

UENV_FILENAME = "uEnv_${DISPLAY_TYPE}.txt"
BOOT_SCRIPTS = "${UENV_FILENAME}:uEnv.txt"

PREFERRED_PROVIDER_virtual/kernel ?= "linux-picosom-dwarf"
PREFERRED_PROVIDER_virtual/kernel_mx6 = "linux-picosom-dwarf"

KERNEL_DEVICETREE = "imx6q-picosom.dtb \
                     imx6dl-picosom.dtb"
KERNEL_IMAGETYPE = "zImage"

MACHINE_FEATURES += "bluetooth pci wifi touchscreen"

MACHINE_EXTRA_RRECOMMENDS += " \
  broadcom-bluetooth \
  openssh-sftp-server \
  libsocketcan \
"

SERIAL_CONSOLE = "115200 ttymxc0"
```

## conf/machine/tek-imx6.conf
```bitbake
#@TYPE: Machine
#@NAME: tek-imx6
#@SOC: i.MX6Q/Dual/DualLite/Solo/QuadPlus
#@DESCRIPTION: Machine configuration for TEK3, TEP/TWP series
#@MAINTAINER: Ray Chang <ray.chang@technexion.com>

MACHINEOVERRIDES =. "mx6:mx6dl:mx6q:"

include conf/machine/include/imx-base.inc
include conf/machine/include/tune-cortexa9.inc
require conf/machine/tn-base.inc

# Kernel Device Trees
KERNEL_DEVICETREE ?= "imx6dl-tek3.dtb imx6q-tek3.dtb \
                      imx6dl-tep5.dtb imx6q-tep5.dtb imx6dl-tep5-15inch.dtb imx6q-tep5-15inch.dtb"

# Bootloader Specifics
UBOOT_MACHINE = "tek-imx6_spl_defconfig"

# Peripherals
# Set Serial console
SERIAL_CONSOLE = "115200;ttymxc0"

# WIC Image
#IMAGE_FSTYPES_append = " wic"
#WIC_FSTAB_BLKDEV = "mmcblk2"
#WIC_CREATE_EXTRA_ARGS = "--no-fstab-update"
#IMAGE_BOOT_FILES = "\
#    ${KERNEL_IMAGETYPE} \
#    imx6-tek*.dtb \
#    ${IMAGE_BOOTFILES} \
#    u-boot-${MACHINE}.${UBOOT_SUFFIX}:u-boot.img \
#"
```

## conf/machine/tep-imx8mp.conf
```bitbake
#@TYPE: Machine
#@NAME: TEP-IMX8MP
#@SOC: i.MX8MP
#@DESCRIPTION: Machine configuration for TechNexion TEP-IMX8MP
#@MAINTAINER: Joe Zhang <joe.zhang@technexion.com>

MACHINEOVERRIDES =. "mx8:mx8m:mx8mp:"

require conf/machine/include/imx-base.inc
require conf/machine/include/tune-cortexa53.inc
require conf/machine/tn-base.inc

# Kernel specifics
KERNEL_DEVICETREE = " \
			freescale/imx8mp-tep.dtb \
			freescale/imx8mp-tep-rpmsg.dtb \
		    freescale/overlays/imx8mp-tep-lvds-vl10112880.dtbo \
		    freescale/overlays/imx8mp-tep-lvds-vl15010276.dtbo \
		    freescale/overlays/imx8mp-tep-lvds-vl156192108.dtbo \
		    freescale/overlays/imx8mp-tep-lvds-vl215192108.dtbo \
		    freescale/overlays/imx8mp-tep-vizionlink-tevi-ap1302.dtbo \
		    freescale/overlays/imx8mp-tep-vizionlink-tevi-ov5640.dtbo \
		    freescale/overlays/imx8mp-tep-vls.dtbo \
		    freescale/overlays/imx8mp-tep-hdmi2mipi-tc358743.dtbo \
		    freescale/overlays/imx8mp-tep-vizionpanel-vl10112880.dtbo \
		    freescale/overlays/imx8mp-tep-vizionpanel-vl15010276.dtbo \
		    freescale/overlays/imx8mp-tep-vizionpanel-vl215192108.dtbo \
"

EXTRA_OEMAKE_append_pn-linux-tn-imx = " DTC_FLAGS='-@ -H epapr'"

# U-boot specifics
UBOOT_CONFIG = "sd fspi"
UBOOT_CONFIG[sd] = "tep-imx8mp_defconfig,sdcard"
UBOOT_CONFIG[fspi] = "tep-imx8mp_defconfig"
UBOOT_CONFIG[mfgtool] = "tep-imx8mp_defconfig"
UBOOT_DTB_NAME = "imx8mp-tep.dtb"

ATF_PLATFORM = "imx8mp"
ATF_LOAD_ADDR = "0x970000"
# Extra firmware package name, that is required to build boot container for fslc bsp
IMX_EXTRA_FIRMWARE = "firmware-imx-8m"
IMX_BOOT_SOC_TARGET = "iMX8MP"
IMX_BOOT_SEEK_mx8mp = "32"

# Set Serial console
SERIAL_CONSOLES = "115200;ttymxc1"

BOOT_SPACE = "65536"

# Set DDR FIRMWARE
DDR_FIRMWARE_NAME_mx8mp = "lpddr4_pmu_train_1d_dmem_202006.bin lpddr4_pmu_train_1d_imem_202006.bin lpddr4_pmu_train_2d_dmem_202006.bin lpddr4_pmu_train_2d_imem_202006.bin"

# WIC Image
M7_MACHINE = "tep-imx8mp"
WKS_FILE_DEPENDS_append = " imx-m7-demos-tn u-boot-fspi-image"
IMAGE_BOOTFILES += "hello_world.bin \
                    fspi_u-boot.bin \
"
WKS_FILE_virtualization = "tn-imx8-imxboot-rootfs-container.wks.in"
WIC_FSTAB_BLKDEV = "mmcblk2"
WIC_CREATE_EXTRA_ARGS_remove_virtualization = "--no-fstab-update"
WIC_PARTITION_TABLE_TYPE ?= "msdos"
IMAGE_FSTYPES_append_virtualization = " wic wic.xz wic.md5sum"
IMAGE_FSTYPES_remove_virtualization = " sdcard sdcard.bz2 sdcard.xz sdcard.md5sum"
IMAGE_BOOT_FILES += "\
    ${IMAGE_BOOTFILES} \
"

IMAGE_INSTALL_append = " se050-tools se050-ssscli lpc802-lanbypass"
IMAGE_INSTALL_remove = " bluetooth wifi"

# virtualization - docker containers
#DOCKERDISKDEPENDS = "${@bb.utils.contains('DISTRO_FEATURES', 'virtualization', 'docker-disk:do_deploy', '', d)}"
#do_image_wic[depends] += "${DOCKERDISKDEPENDS}"
#TN_DOCKER_PARTITION_IMAGE = "docker-data-partition.img"
#TN_DOCKER_PARTITION_MOUNT = "/var/lib/docker"
#TN_DOCKER_PARTITION_SIZE = "4096"
```

## conf/machine/tep1-imx6ul.conf
```bitbake
#@TYPE: Machine
#@NAME: tep1-imx6ul
#@SOC: i.MX6UL
#@DESCRIPTION: Machine configuration for TEP1-IMX6UL

MACHINEOVERRIDES =. "mx6:mx6ul:"

include conf/machine/include/imx-base.inc
include conf/machine/include/tune-cortexa7.inc

BBMASK += "\
  meta-fsl-bsp-release/imx/meta-sdk/recipes-fsl/packagegroup/packagegroup-fsl-optee-imx.bb \
  meta-fsl-bsp-release/imx/meta-bsp/recipes-security/optee-imx/optee-os-imx_git.bb \
"

#
# Bootloader Specifics
#
PREFERRED_PROVIDER_u-boot = "u-boot-edm"
PREFERRED_PROVIDER_u-boot_mx6ul = "u-boot-edm"
PREFERRED_PROVIDER_virtual/bootloader = "u-boot-edm"
PREFERRED_PROVIDER_virtual/bootloader_mx6ul = "u-boot-edm"
UBOOT_MAKE_TARGET = ""
UBOOT_SUFFIX = "img"
SPL_BINARY = "SPL"
UBOOT_MACHINE = "tep1-imx6ul_spl_defconfig"

#
# Kernel Specifics
#
PREFERRED_PROVIDER_virtual/kernel ?= "linux-tn-imx"
PREFERRED_PROVIDER_virtual/kernel_mx6ul = "linux-tn-imx"

KERNEL_DEVICETREE = "imx6ul-tep1.dtb"

KERNEL_IMAGETYPE = "zImage"

#
# Extra Stuff
#
MACHINE_FEATURES += "touchscreen"

MACHINE_EXTRA_RRECOMMENDS += " \
  openssh-sftp-server \
  libsocketcan \
  bash dnsmasq haveged iptables \
"
MACHINE_FIRMWARE_remove = "firmware-imx-brcm"

IMAGE_INSTALL_append_tep1-imx6ul = " packagegroup-tn-wlan net-tools wireless-tools"

#
# Peripherals
#
# Set Serial console
SERIAL_CONSOLE = "115200;ttymxc1"

IMAGE_CLASSES += "image_types_fsl_tn"
IMAGE_CLASSES_remove = "image_types_fsl"
HOSTTOOLS_NONFATAL += "git-lfs"
LICENSE_FLAGS_WHITELIST += "commercial_qca commercial_brcm"
```

## conf/machine/tep1-imx7.conf
```bitbake
#@TYPE: Machine
#@NAME: tep1-imx7
#@SOC: i.MX7D
#@DESCRIPTION: Machine configuration for TEP1-IMX7

MACHINEOVERRIDES =. "mx7:mx7d:"

include conf/machine/include/imx-base.inc
include conf/machine/include/tune-cortexa7.inc

BBMASK += "\
  meta-fsl-bsp-release/imx/meta-sdk/recipes-fsl/packagegroup/packagegroup-fsl-optee-imx.bb \
  meta-fsl-bsp-release/imx/meta-bsp/recipes-security/optee-imx/optee-os-imx_git.bb \
"

#
# Bootloader Specifics
#
PREFERRED_PROVIDER_u-boot = "u-boot-edm"
PREFERRED_PROVIDER_u-boot_mx7 = "u-boot-edm"
PREFERRED_PROVIDER_virtual/bootloader = "u-boot-edm"
PREFERRED_PROVIDER_virtual/bootloader_mx7 = "u-boot-edm"

UBOOT_MAKE_TARGET = ""
UBOOT_SUFFIX = "img"
SPL_BINARY = "SPL"
UBOOT_MACHINE = "tep1-imx7d_spl_defconfig"

#
# Kernel Specifics
#
PREFERRED_PROVIDER_virtual/kernel ?= "linux-tn-imx"
PREFERRED_PROVIDER_virtual/kernel_mx7 = "linux-tn-imx"

KERNEL_DEVICETREE ?= "imx7d-tep1.dtb imx7d-tep1-a2.dtb"

KERNEL_IMAGETYPE = "zImage"

#
# Extra Stuff
#
MACHINE_FEATURES += "pci touchscreen"

# mx7 GPU libraries
PREFERRED_PROVIDER_virtual/egl_mx7d = "mesa"
PREFERRED_PROVIDER_virtual/libgles1_mx7d = "mesa"
PREFERRED_PROVIDER_virtual/libgles2_mx7d = "mesa"
PREFERRED_PROVIDER_virtual/libgl_mx7d = "mesa"
PREFERRED_PROVIDER_virtual/libg2d_mx7d = ""

MACHINEOVERRIDES_EXTENDER_mx7d   = "imxpxp:imxepdc"

# MESA DRI library
XSERVER += "mesa-driver-swrast"

MACHINE_EXTRA_RRECOMMENDS += " \
  openssh-sftp-server \
  libsocketcan \
  bash hostapd dnsmasq haveged create-ap iptables \
"

IMAGE_INSTALL_append_tep1-imx7 = " packagegroup-tn-wlan net-tools wireless-tools"

#
# Peripherals
#
# Set Serial console
SERIAL_CONSOLE = "115200;ttymxc1"

IMAGE_CLASSES += "image_types_fsl_tn"
IMAGE_CLASSES_remove = "image_types_fsl"
HOSTTOOLS_NONFATAL += "git-lfs"
LICENSE_FLAGS_WHITELIST += "commercial_qca commercial_brcm"
```

## conf/machine/tep3-imx6ul.conf
```bitbake
#@TYPE: Machine
#@NAME: tep3-imx6ul
#@SOC: i.MX6UL
#@DESCRIPTION: Machine configuration for tep3-imx6ul

include conf/machine/include/imx-base.inc
include conf/machine/include/tune-cortexa7.inc
include conf/machine/include/imx6ul-common.inc

SOC_FAMILY = "mx6ul"

PREFERRED_PROVIDER_u-boot = "u-boot-edm"
PREFERRED_PROVIDER_u-boot_mx6 = "u-boot-edm"
PREFERRED_PROVIDER_virtual/bootloader = "u-boot-edm"
PREFERRED_PROVIDER_virtual/bootloader_mx6 = "u-boot-edm"
UBOOT_MAKE_TARGET = ""
UBOOT_MACHINE = "tep3-imx6ul_defconfig"

PREFERRED_PROVIDER_virtual/kernel ?= "linux-tn-imx"
PREFERRED_PROVIDER_virtual/kernel_mx6ul = "linux-tn-imx"

KERNEL_DEVICETREE = "imx6ul-tep3.dtb"

KERNEL_IMAGETYPE = "zImage"

MACHINE_FEATURES += "pci touchscreen"

MACHINE_EXTRA_RRECOMMENDS += " \
  openssh-sftp-server \
  libsocketcan \
"

SERIAL_CONSOLE = "115200 ttymxc0"
```
