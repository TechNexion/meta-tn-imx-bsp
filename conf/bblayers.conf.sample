## conf/machine/pico-imx7.conf
```bitbake
#@TYPE: Machine
#@NAME: pico-imx7
#@SOC: i.MX7/Solo/Dual/UtraLowPower
#@DESCRIPTION: Machine configuration for PICO-IMX7 with QCA(Qualcomm)/BRCM(Broadcom) WLAN module
#@MAINTAINER: Po Cheng <po.cheng@technexion.com>

MACHINEOVERRIDES =. "mx7:mx7d:"
MACHINEOVERRIDES_EXTENDER_pico-imx7 = "uenv"

include conf/machine/include/imx-base.inc
include conf/machine/include/tune-cortexa7.inc
require conf/machine/tn-base.inc

# Kernel Device Trees
KERNEL_DEVICETREE = "imx7d-pico-pi-qca.dtb imx7d-pico-pi.dtb \
                     imx7d-pico-nymph-qca.dtb imx7d-pico-nymph.dtb \
                     imx7d-pico-dwarf-qca.dtb imx7d-pico-dwarf.dtb \
                     imx7d-pico-hobbit-qca.dtb imx7d-pico-hobbit.dtb \
"
# Setup the additional devicetree file
KERNEL_DEVICETREE_append_voicehat = " imx7d-pico-pi-voicehat.dtb"

# Bootloader Specifics
UBOOT_MACHINE = "pico-imx7d_spl_defconfig"

#M4_MACHINE = "pico-imx7d-pi"
#IMAGE_BOOTFILES_DEPENDS += "imx-m4-demos-tn:do_deploy"
#IMAGE_BOOTFILES += "hello_world.bin rpmsg_lite_pingpong_rtos_linux_remote.bin rpmsg_lite_str_echo_rtos_imxcm4.bin"

# override extender for graphics libs
MACHINEOVERRIDES_EXTENDER_mx7d = "imxpxp:imxepdc"
# mx7 GPU libraries
PREFERRED_PROVIDER_virtual/egl_mx7d = "mesa"
PREFERRED_PROVIDER_virtual/libgles1_mx7d = "mesa"
PREFERRED_PROVIDER_virtual/libgles2_mx7d = "mesa"
PREFERRED_PROVIDER_virtual/libgl_mx7d = "mesa"
PREFERRED_PROVIDER_virtual/libg2d_mx7d = ""
# MESA DRI library
XSERVER_mx7d += "mesa-driver-swrast"

# Peripherals
# Set Serial console
SERIAL_CONSOLE = "115200;ttymxc4"
SERIAL_BLUETOOTH = "3000000;ttymxc6"

# WIC Image
#WIC_FSTAB_BLKDEV = "mmcblk2"
#WIC_CREATE_EXTRA_ARGS = "--no-fstab-update"
#IMAGE_FSTYPES_append = " wic"
#IMAGE_BOOT_FILES = "\
#    ${KERNEL_IMAGETYPE} \
#    imx7d-pico*.dtb \
#    ${IMAGE_BOOTFILES} \
#    u-boot-${MACHINE}.${UBOOT_SUFFIX}:u-boot.img \
#"
```

## conf/machine/pico-imx8m.conf
```bitbake
#@TYPE: Machine
#@NAME: PICO-IMX8M
#@SOC: i.MX8MQ
#@DESCRIPTION: Machine configuration for PICO-IMX8M
#@MAINTAINER: Richard Hu <richard.hu@technexion.com>

MACHINEOVERRIDES =. "mx8:mx8mq:"

require conf/machine/include/imx-base.inc
require conf/machine/include/arm/arch-arm64.inc

BBMASK += "\
  meta-fsl-bsp-release/imx/meta-sdk/recipes-fsl/packagegroup/packagegroup-fsl-optee-imx.bb \
  meta-fsl-bsp-release/imx/meta-bsp/recipes-security/optee-imx/optee-os-imx_git.bb \
"

MACHINE_SOCARCH_FILTER_append_mx8mq = "virtual/libopenvg virtual/libgles1 virtual/libgles2 virtual/egl virtual/mesa virtual/libgl virtual/libg2d"

#
# Kernel Specifics
#
PREFERRED_PROVIDER_virtual/kernel ?= "linux-tn-imx"
PREFERRED_PROVIDER_virtual/kernel_mx8mq = "linux-tn-imx"

# Add kernel modules
MACHINE_EXTRA_RRECOMMENDS += "\
    kernel-module-qcacld-tn \
"

KERNEL_DEVICETREE ?= "freescale/pico-8m.dtb freescale/pico-8m-dcss-ili9881c.dtb"

#IMAGE_M4LOADER = "imx-m4-demos"
#IMAGE_M4 = "imx8mq_m4_TCM_hello_world.bin imx8mq_m4_TCM_rpmsg_lite_pingpong_rtos_linux_remote.bin imx8mq_m4_TCM_rpmsg_lite_str_echo_rtos.bin"

#
# Bootloader Specifics
#
PREFERRED_PROVIDER_u-boot = "u-boot-edm"
PREFERRED_PROVIDER_u-boot_mx8mq = "u-boot-edm"
PREFERRED_PROVIDER_virtual/bootloader = "u-boot-edm"
PREFERRED_PROVIDER_virtual/bootloader_mx8mq = "u-boot-edm"

UBOOT_CONFIG ??= "sd"
UBOOT_CONFIG[sd] = "pico-8m_defconfig,sdcard"
UBOOT_CONFIG[mfgtool] = "pico-8m_defconfig"
SPL_BINARY = "spl/u-boot-spl.bin"

# Ensure uEnv.txt will be available at rootfs time
do_rootfs[depends] += "u-boot-uenv:do_deploy"

UENV_FILENAME = "uEnv.txt"
BOOT_SCRIPTS = "${UENV_FILENAME}:uEnv.txt"

# Set DDR FIRMWARE
DDR_FIRMWARE_NAME = "lpddr4_pmu_train_1d_imem.bin lpddr4_pmu_train_1d_dmem.bin lpddr4_pmu_train_2d_imem.bin lpddr4_pmu_train_2d_dmem.bin"

# Set u-boot DTB
UBOOT_DTB_NAME = "pico-8m.dtb"

# Set imx-mkimage boot target
IMXBOOT_TARGETS = "flash_evk flash_evk_no_hdmi"

IMAGE_BOOTLOADER = "imx-boot"

BOOT_SPACE = "32768"

LOADADDR = ""
UBOOT_SUFFIX = "bin"
UBOOT_MAKE_TARGET = ""
IMX_BOOT_SEEK = "33"

OPTEE_BIN_EXT = "8mq"

MACHINE_EXTRA_RRECOMMENDS += " \
  openssh-sftp-server \
  libsocketcan \
  bash hostapd dnsmasq haveged create-ap iptables \
"

#
# Extra Stuff
#
MACHINE_FEATURES += " pci wifi bluetooth"

IMAGE_INSTALL_append_pico-imx8m = " packagegroup-tn-wlan"

#
# Peripherals
#
# Set Serial console
SERIAL_CONSOLE = "115200;ttymxc0"

IMAGE_CLASSES += "image_types_fsl_tn"
IMAGE_CLASSES_remove = "image_types_fsl"
HOSTTOOLS_NONFATAL += "git-lfs"
LICENSE_FLAGS_WHITELIST += "commercial_qca commercial_brcm"
```

## conf/machine/pico-imx8mm.conf
```bitbake
#@TYPE: Machine
#@NAME: PICO-IMX8MM
#@SOC: i.MX8MM
#@DESCRIPTION: Machine configuration for PICO-IMX8MM
#@MAINTAINER: Po Cheng <po.cheng@technexion.com>

MACHINEOVERRIDES =. "mx8:mx8m:mx8mm:"

require conf/machine/include/imx-base.inc
require conf/machine/include/arm/arch-arm64.inc
require conf/machine/tn-base.inc

# Kernel Device Trees
KERNEL_DEVICETREE_pico-imx8mm = "freescale/imx8mm-pico-pi.dtb \
                                 freescale/imx8mm-pico-pi-m4.dtb \
                                 freescale/imx8mm-pico-pi-ili9881c.dtb \
                                 freescale/imx8mm-pico-pi-g080uan01.dtb \
                                 freescale/imx8mm-pico-pi-g101uan02.dtb \
                                 freescale/imx8mm-pico-pi-sn65dsi84-hj070na.dtb \
                                 freescale/imx8mm-pico-pi-sn65dsi84-m101nwwb.dtb \
                                 freescale/overlays/imx8mm-pico-pi-mipi_5.dtbo \
                                 freescale/overlays/imx8mm-pico-pi-voicehat.dtbo \
"
# Setup the additional devicetree file
KERNEL_DEVICETREE_append_voicehat = " freescale/imx8mm-pico-pi-voicehat.dtb"
KERNEL_DEVICETREE_append_nfc = " freescale/imx8mm-pico-pi-nfc.dtb"
EXTRA_OEMAKE_append_pn-linux-tn-imx = " DTC_FLAGS='-@ -H epapr'"

M4_MACHINE = "pico-imx8mm-pi"
IMAGE_BOOTFILES_DEPENDS += "imx-m4-demos-tn:do_deploy"
IMAGE_BOOTFILES += "hello_world.bin rpmsg_lite_pingpong_rtos_linux_remote.bin rpmsg_lite_str_echo_rtos_imxcm4.bin"

# Bootloader Specifics
UBOOT_CONFIG[sd] = "pico-imx8mm_defconfig,sdcard"
UBOOT_CONFIG[mfgtool] = "pico-imx8mm_defconfig"

# Set u-boot DTB
UBOOT_DTB_NAME = "imx8mm-pico-pi.dtb"

# Peripherals
# Set Serial console
SERIAL_CONSOLES = "115200;ttymxc1"
SERIAL_BLUETOOTH = "3000000;ttymxc0"

# WIC Image
WIC_FSTAB_BLKDEV = "mmcblk2"
#WIC_CREATE_EXTRA_ARGS = "--no-fstab-update"
IMAGE_FSTYPES_append = " wic"
IMAGE_BOOT_FILES = "\
    ${KERNEL_IMAGETYPE} \
    imx8mm-pico*.dtb \
    ${IMAGE_BOOTFILES} \
"
do_image_wic[depends] += "imx-m4-demos-tn:do_deploy"

# meta-virtualization
DISTRO_FEATURES_append_pico-imx8mm = " virtualization"

# meta-updater
OSTREE_INITRAMFS_FSTYPES = "ext4.gz"
```
