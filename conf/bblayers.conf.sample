## conf/machine/edm-imx95.conf
```bitbake
#@TYPE: Machine
#@NAME: NXP i.MX 95 19x19 Evaluation Kit with LPDDR5
#@SOC: i.MX95
#@DESCRIPTION: Machine configuration for TechNexion EDM-IMX95
#@MAINTAINER: Richard Hu <richard.hu@technexion.com>

MACHINEOVERRIDES =. "mx95:"

require conf/machine/include/imx-base.inc
require conf/machine/include/arm/armv8-2a/tune-cortexa55.inc
require conf/machine/tn-base.inc

KERNEL_DEVICETREE = " \
    freescale/imx95-edm-evm.dtb \
    freescale/imx95-edm-evm-lvds-vl10112880.dtb \
    freescale/imx95-edm-evm-lvds-vl156192108.dtb \
    freescale/imx95-edm-evm-mipi2hdmi-adv7535.dtb \
    freescale/imx95-edm-evm-tevs-csi1.dtb \
    freescale/imx95-edm-evm-tevs.dtb \
    freescale/imx95-edm-evm-fusion-lvds-vl10112880.dtb \
    freescale/imx95-edm-evm-fusion-lvds-vl156192108.dtb \
    freescale/imx95-edm-evm-vls-gm2-csi0-lvds-vl10112880.dtb \
    freescale/imx95-edm-evm-vls-gm2-csi1-lvds-vl10112880.dtb \
    freescale/imx95-edm-evm-vls-gm2-ext-fsync-lvds-vl10112880.dtb \
    freescale/imx95-edm-evm-vls-gm2-fsync-lvds-vl10112880.dtb \
    freescale/imx95-edm-evm-vls-gm2-lvds-vl10112880.dtb \
"

# U-boot specifics
UBOOT_CONFIG ??= "sd"
UBOOT_CONFIG[sd] = "edm-imx95_defconfig,sdcard"

ATF_PLATFORM = "imx95"
OEI_CONFIGS = "ddr tcm"
OEI_CORE   = "m33"
OEI_SOC    = "mx95"
OEI_BOARD  = "edm-imx95"
DDR_TYPE   = "lpddr5"

IMXBOOT_TARGETS_BASENAME = "flash"

IMXBOOT_VARIANTS = "alt jailhouse netc rpmsg sof"

# Multiple system manager configs by IMXBOOT_VARIANT
SYSTEM_MANAGER_CONFIG = \
    "${@bb.utils.contains('IMXBOOT_VARIANT', 'alt',       'mx95alt', \
        bb.utils.contains('IMXBOOT_VARIANT', 'jailhouse', 'mx95evkjailhouse', \
        bb.utils.contains('IMXBOOT_VARIANT', 'netc',      'mx95netc', \
        bb.utils.contains('IMXBOOT_VARIANT', 'rpmsg',     'mx95evkrpmsg', \
        bb.utils.contains('IMXBOOT_VARIANT', 'sof',       'mx95evksof', \
                                                          'mx95evk', d), d), d), d), d)}"

# imx-boot (flash.bin) targets based on UBOOT_CONFIG and IMXBOOT_VARIANT
IMXBOOT_TARGETS_SD = " \
    ${@bb.utils.contains('IMXBOOT_VARIANT', 'alt',       '${IMXBOOT_TARGETS_BASENAME}_alt', \
       bb.utils.contains('IMXBOOT_VARIANT', 'jailhouse', '${IMXBOOT_TARGETS_BASENAME}_jailhouse', \
       bb.utils.contains('IMXBOOT_VARIANT', 'netc',      '${IMXBOOT_TARGETS_BASENAME}_netc', \
       bb.utils.contains('IMXBOOT_VARIANT', 'rpmsg',     '${IMXBOOT_TARGETS_BASENAME}_lpboot_sm_a55', \
       bb.utils.contains('IMXBOOT_VARIANT', 'sof',       '${IMXBOOT_TARGETS_BASENAME}_a55', \
                                                         '${IMXBOOT_TARGETS_BASENAME}_all ${IMXBOOT_TARGETS_BASENAME}_a55', d), d), d), d), d)} \
"

# We have to disable SERIAL_CONSOLE due to auto-serial-console
SERIAL_CONSOLES = "115200;ttyLP0"

DDR_FIRMWARE_NAME = " \
    lpddr5_dmem_v202409.bin \
    lpddr5_dmem_qb_v202409.bin \
    lpddr5_imem_v202409.bin \
    lpddr5_imem_qb_v202409.bin \
"
M4_DEFAULT_IMAGE_MX95 = "${@bb.utils.contains('SYSTEM_MANAGER_CONFIG', 'mx95netc', 'imx95-19x19-evk_m7_TCM_netc_share.bin', \
                                                                                   'imx95-19x19-evk_m7_TCM_power_mode_switch.bin', d)}"

IMX_BOOT_SOC_TARGET = "iMX95"
IMX_BOOT_SEEK = "32"

# We have to disable SERIAL_CONSOLE due to auto-serial-console
SERIAL_CONSOLES = "115200;ttyLP0"

IMX_DEFAULT_BSP = "nxp"
```

## conf/machine/edm1-cf-imx6-no-console.conf
```bitbake
#@TYPE: Machine
#@NAME: edm1-cf-imx6-no-console
#@SOC: i.MX6Q/Dual/DualLite/Solo
#@DESCRIPTION: Machine configuration for edm1-cf-imx6 and redirect console to ttyUSB0

include conf/machine/include/imx-base.inc
include conf/machine/include/tune-cortexa9.inc

SOC_FAMILY = "mx6:mx6dl:mx6q"

PREFERRED_PROVIDER_u-boot = "u-boot-edm"
PREFERRED_PROVIDER_u-boot_mx6 = "u-boot-edm"
PREFERRED_PROVIDER_virtual/bootloader = "u-boot-edm"
PREFERRED_PROVIDER_virtual/bootloader_mx6 = "u-boot-edm"
UBOOT_MAKE_TARGET = ""
UBOOT_SUFFIX = "img"
SPL_BINARY = "SPL"
UBOOT_MACHINE = "edm-cf-imx6-no-console_defconfig"

UENV_FILENAME = "uEnv.txt"
BOOT_SCRIPTS = "${UENV_FILENAME}:uEnv.txt"

PREFERRED_PROVIDER_virtual/kernel ?= "linux-tn-imx"
PREFERRED_PROVIDER_virtual/kernel_mx6 = "linux-tn-imx"

KERNEL_DEVICETREE = "imx6dl-edm1-cf_fairy.dtb imx6q-edm1-cf_fairy.dtb \
                     imx6dl-edm1-cf-pmic_fairy.dtb imx6q-edm1-cf-pmic_fairy.dtb imx6qp-edm1-cf-pmic_fairy.dtb \
                     imx6dl-edm1-cf_tc0700.dtb imx6q-edm1-cf_tc0700.dtb \
                     imx6dl-edm1-cf-pmic_tc0700.dtb imx6q-edm1-cf-pmic_tc0700.dtb imx6qp-edm1-cf-pmic_tc0700.dtb"

KERNEL_IMAGETYPE = "zImage"

MACHINE_FEATURES += "bluetooth pci wifi touchscreen"

MACHINE_EXTRA_RRECOMMENDS += " \
  firmware-bcmdhd \
  broadcom-bluetooth \
  openssh-sftp-server \
  libsocketcan \
"

SERIAL_CONSOLE = "115200 ttyUSB0"
```

## conf/machine/edm1-cf-imx6sx.conf
```bitbake
#@TYPE: Machine
#@NAME: edm1-cf-imx6sx
#@SOC: i.MX6SX
#@DESCRIPTION: Machine configuration for edm1-cf-imx6sx

include conf/machine/include/imx-base.inc
include conf/machine/include/tune-cortexa9.inc

SOC_FAMILY = "mx6:mx6sx"

PREFERRED_PROVIDER_u-boot = "u-boot-edm"
PREFERRED_PROVIDER_u-boot_mx6 = "u-boot-edm"
PREFERRED_PROVIDER_virtual/bootloader = "u-boot-edm"
PREFERRED_PROVIDER_virtual/bootloader_mx6 = "u-boot-edm"
UBOOT_MAKE_TARGET = ""
UBOOT_SUFFIX = "img"
SPL_BINARY = "SPL"
UBOOT_MACHINE = "edm1-cf-imx6sx_spl_defconfig"

PREFERRED_PROVIDER_virtual/kernel ?= "linux-tn-imx"
PREFERRED_PROVIDER_virtual/kernel_mx6 = "linux-tn-imx"

KERNEL_DEVICETREE = "imx6sx-edm1-cf.dtb imx6sx-edm1-cf-m4.dtb"

KERNEL_IMAGETYPE = "zImage"

MACHINE_FEATURES += "bluetooth pci wifi touchscreen"

MACHINE_EXTRA_RRECOMMENDS += " \
  firmware-bcmdhd \
  broadcom-bluetooth \
  openssh-sftp-server \
  libsocketcan \
  bash hostapd dnsmasq haveged create-ap iptables \
"

SERIAL_CONSOLE = "115200 ttymxc0"
```

## conf/machine/flex-imx8mm.conf
```bitbake
#@TYPE: Machine
#@NAME: FLEX-IMX8MM
#@SOC: i.MX8MM
#@DESCRIPTION: Machine configuration for FLEX-IMX8MM
#@MAINTAINER: Ray Cheng <ray.cheng@technexion.com>

MACHINEOVERRIDES =. "mx8:mx8m:mx8mm:"

require conf/machine/include/imx-base.inc
require conf/machine/include/arm/arch-arm64.inc

MACHINE_SOCARCH_FILTER_append_mx8mm = "virtual/libopenvg virtual/libgles1 virtual/libgles2 virtual/egl virtual/mesa virtual/libgl virtual/libg2d"

#
# Kernel Specifics
#
PREFERRED_PROVIDER_virtual/kernel ?= "linux-tn-imx"
PREFERRED_PROVIDER_virtual/kernel_mx8mm = "linux-tn-imx"

KERNEL_DEVICETREE ?= "freescale/imx8mm-flex-pi.dtb \
                      freescale/imx8mm-flex-pi-m4.dtb \
                      freescale/imx8mm-flex-pi-ili9881c.dtb \
                      freescale/imx8mm-flex-pi-ili9881c-m4.dtb \
                      freescale/imx8mm-flex-pi-voicehat.dtb"

#IMAGE_M4LOADER = "imx-m4-demos"
#IMAGE_M4 = "imx8mq_m4_TCM_hello_world.bin imx8mq_m4_TCM_rpmsg_lite_pingpong_rtos_linux_remote.bin imx8mq_m4_TCM_rpmsg_lite_str_echo_rtos.bin"

#
# Bootloader Specifics
#
PREFERRED_PROVIDER_u-boot = "u-boot-edm"
PREFERRED_PROVIDER_u-boot_mx8mm = "u-boot-edm"
PREFERRED_PROVIDER_virtual/bootloader = "u-boot-edm"
PREFERRED_PROVIDER_virtual/bootloader_mx8mm = "u-boot-edm"

UBOOT_CONFIG ??= "sd"
UBOOT_CONFIG[sd] = "flex-imx8mm_defconfig,sdcard"
UBOOT_CONFIG[mfgtool] = "flex-imx8mm_defconfig"
SPL_BINARY = "spl/u-boot-spl.bin"

# Set DDR FIRMWARE
DDR_FIRMWARE_NAME = "lpddr4_pmu_train_1d_imem.bin lpddr4_pmu_train_1d_dmem.bin lpddr4_pmu_train_2d_imem.bin lpddr4_pmu_train_2d_dmem.bin"

# Set u-boot DTB
UBOOT_DTB_NAME = "imx8mm-flex-pi.dtb"

# Set imx-mkimage boot target
IMXBOOT_TARGETS = "flash_evk "

IMAGE_BOOTLOADER = "imx-boot"

BOOT_SPACE = "65536"

LOADADDR = ""
UBOOT_SUFFIX = "bin"
UBOOT_MAKE_TARGET = ""
IMX_BOOT_SEEK = "33"

OPTEE_BIN_EXT = "8mm"

#
# Extra Stuff
#
MACHINE_FEATURES += " pci wifi bluetooth"

MACHINE_EXTRA_RRECOMMENDS += " \
  openssh-sftp-server \
  libsocketcan \
  bash hostapd dnsmasq haveged create-ap iptables \
"

IMAGE_INSTALL_append_mx8 = " packagegroup-tn-wlan "
IMAGE_INSTALL_append_flex-imx8mm = " packagegroup-tn-voicehat "

#
# Peripherals
#
SERIAL_CONSOLES = "115200;ttymxc1"
HOSTTOOLS_NONFATAL += "git-lfs"
LICENSE_FLAGS_WHITELIST += "commercial_qca commercial_brcm"
```

## conf/machine/imx8mp-ddr4-evk-extra.conf
```bitbake
KERNEL_DEVICETREE_append = " \
	freescale/imx8mp-evk-vizionlink-tevi-ap1302.dtb \
	freescale/imx8mp-evk-tevi-ap1302.dtb \
"
OVERRIDES_append = ":tevi"
```

## conf/machine/imx8mp-lpddr4-evk-extra.conf
```bitbake
KERNEL_DEVICETREE_append = " \
	freescale/imx8mp-evk-vizionlink-tevi-ap1302.dtb \
	freescale/imx8mp-evk-tevi-ap1302.dtb \
"
#OVERRIDES_append = ":tn"
PREFERRED_PROVIDER_virtual/kernel_imx ?= "linux-tn-imx"
#PREFERRED_PROVIDER_kernel_tn = "linux-tn-imx"
#PREFERRED_PROVIDER_virtual/kernel_tn = "linux-tn-imx"
```

## conf/machine/pico-imx6-brcm.conf
```bitbake
#@TYPE: Machine
#@NAME: pico-imx6-brcm
#@SOC: i.MX6Q/Dual/DualLite/Solo
#@DESCRIPTION: Machine configuration for PICO-IMX6 with Broadcom WLAN module

MACHINEOVERRIDES =. "mx6:mx6dl:mx6q:"

include conf/machine/include/imx-base.inc
include conf/machine/include/tune-cortexa9.inc

PREFERRED_PROVIDER_u-boot = "u-boot-edm"
PREFERRED_PROVIDER_u-boot_mx6 = "u-boot-edm"
PREFERRED_PROVIDER_virtual/bootloader = "u-boot-edm"
PREFERRED_PROVIDER_virtual/bootloader_mx6 = "u-boot-edm"

UBOOT_MAKE_TARGET = ""
UBOOT_SUFFIX = "img"
SPL_BINARY = "SPL"
UBOOT_MACHINE = "pico-imx6_spl_defconfig"

# Ensure uEnv.txt will be available at rootfs time
do_rootfs[depends] += "u-boot-uenv:do_deploy"

UENV_FILENAME = "uEnv.txt"
BOOT_SCRIPTS = "${UENV_FILENAME}:uEnv.txt"

PREFERRED_PROVIDER_virtual/kernel ?= "linux-tn-imx"
PREFERRED_PROVIDER_virtual/kernel_mx6 = "linux-tn-imx"

KERNEL_DEVICETREE ?= "imx6dl-pico_pi.dtb imx6q-pico_pi.dtb \
                      imx6dl-pico_nymph.dtb imx6q-pico_nymph.dtb \
                      imx6dl-pico_dwarf.dtb imx6q-pico_dwarf.dtb \
                      imx6dl-pico_hobbit.dtb imx6q-pico_hobbit.dtb"

KERNEL_IMAGETYPE = "zImage"

MACHINE_FEATURES += "bluetooth pci wifi touchscreen"

MACHINE_EXTRA_RRECOMMENDS += " \
  broadcom-bluetooth \
  openssh-sftp-server \
  libsocketcan \
  bash hostapd dnsmasq haveged create-ap iptables \
"

MACHINE_FIRMWARE_remove = "firmware-imx-brcm"

SERIAL_CONSOLE = "115200 ttymxc0"
```

## conf/machine/pico-imx6.conf
```bitbake
#@TYPE: Machine
#@NAME: pico-imx6
#@SOC: i.MX6Q/Dual/DualLite/Solo
#@DESCRIPTION: Machine configuration for PICO-IMX6 with QCA(Qualcomm)/BRCM(Broadcom) WLAN module 

MACHINEOVERRIDES =. "mx6:mx6dl:mx6q:"

include conf/machine/include/imx-base.inc
include conf/machine/include/tune-cortexa9.inc

BBMASK += "\
  meta-fsl-bsp-release/imx/meta-sdk/recipes-fsl/packagegroup/packagegroup-fsl-optee-imx.bb \
  meta-fsl-bsp-release/imx/meta-bsp/recipes-security/optee-imx/optee-os-imx_git.bb \
"

#
# Bootloader Specifics
#
PREFERRED_PROVIDER_u-boot = "u-boot-edm"
PREFERRED_PROVIDER_u-boot_mx6 = "u-boot-edm"
PREFERRED_PROVIDER_virtual/bootloader = "u-boot-edm"
PREFERRED_PROVIDER_virtual/bootloader_mx6 = "u-boot-edm"

UBOOT_MAKE_TARGET = ""
UBOOT_SUFFIX = "img"
SPL_BINARY = "SPL"
UBOOT_MACHINE = "pico-imx6_spl_defconfig"

# Ensure uEnv.txt will be available at rootfs time
do_rootfs[depends] += "u-boot-uenv:do_deploy"

UENV_FILENAME = "uEnv.txt"
BOOT_SCRIPTS = "${UENV_FILENAME}:uEnv.txt"

#
# Kernel Specifics
#
PREFERRED_PROVIDER_virtual/kernel ?= "linux-tn-imx"
PREFERRED_PROVIDER_virtual/kernel_mx6 = "linux-tn-imx"

KERNEL_DEVICETREE ?= "imx6dl-pico-qca_pi.dtb imx6q-pico-qca_pi.dtb \
                      imx6dl-pico-qca_nymph.dtb imx6q-pico-qca_nymph.dtb \
                      imx6dl-pico-qca_dwarf.dtb imx6q-pico-qca_dwarf.dtb \
                      imx6dl-pico-qca_hobbit.dtb imx6q-pico-qca_hobbit.dtb \
                      imx6dl-pico_pi.dtb imx6q-pico_pi.dtb \
                      imx6dl-pico_nymph.dtb imx6q-pico_nymph.dtb \
                      imx6dl-pico_dwarf.dtb imx6q-pico_dwarf.dtb \
                      imx6dl-pico_hobbit.dtb imx6q-pico_hobbit.dtb"

KERNEL_IMAGETYPE = "zImage"

#
# Extra Stuff
#
MACHINE_FEATURES += "bluetooth pci wifi touchscreen"

MACHINE_EXTRA_RRECOMMENDS += " \
  broadcom-bluetooth \
  openssh-sftp-server \
  libsocketcan \
  bash hostapd dnsmasq haveged create-ap iptables \
"

IMAGE_INSTALL_append_pico-imx6 = " packagegroup-tn-wlan"

#
# Peripherals
#
# Set Serial console
SERIAL_CONSOLE = "115200;ttymxc0"
SERIAL_BLUETOOTH = "3000000;ttymxc1"

IMAGE_CLASSES += "image_types_fsl_tn"
IMAGE_CLASSES_remove = "image_types_fsl"
HOSTTOOLS_NONFATAL += "git-lfs"
LICENSE_FLAGS_WHITELIST += "commercial_qca commercial_brcm"
```

## conf/machine/pico-imx6ul-emmc.conf
```bitbake
#@TYPE: Machine
#@NAME: pico-imx6ul-emmc
#@SOC: i.MX6UL
#@DESCRIPTION: Machine configuration for pico-imx6ul

include conf/machine/include/imx-base.inc
include conf/machine/include/tune-cortexa7.inc
include conf/machine/include/imx6ul-common.inc

SOC_FAMILY = "mx6ul"

PREFERRED_PROVIDER_u-boot = "u-boot-edm"
PREFERRED_PROVIDER_u-boot_mx6 = "u-boot-edm"
PREFERRED_PROVIDER_virtual/bootloader = "u-boot-edm"
PREFERRED_PROVIDER_virtual/bootloader_mx6 = "u-boot-edm"
UBOOT_MAKE_TARGET = ""
UBOOT_SUFFIX = "img"
SPL_BINARY = "SPL"
UBOOT_MACHINE = "picosom-imx6ul_spl_defconfig"

PREFERRED_PROVIDER_virtual/kernel ?= "linux-tn-imx"
PREFERRED_PROVIDER_virtual/kernel_mx6ul = "linux-tn-imx"

KERNEL_DEVICETREE = "imx6ul-pico_hobbit.dtb"

KERNEL_IMAGETYPE = "zImage"

MACHINE_FEATURES += "bluetooth pci wifi touchscreen"

MACHINE_EXTRA_RRECOMMENDS += " \
  firmware-bcmdhd \
  broadcom-bluetooth \
  openssh-sftp-server \
  libsocketcan \
  bash hostapd dnsmasq haveged create-ap iptables \
"

SERIAL_CONSOLE = "115200 ttymxc5"
```

## conf/machine/pico-imx6ul-nand.conf
```bitbake
#@TYPE: Machine
#@NAME: pico-imx6ul-nand
#@SOC: i.MX6UL
#@DESCRIPTION: Machine configuration for pico-imx6ul-nand

include conf/machine/include/imx-base.inc
include conf/machine/include/tune-cortexa7.inc
include conf/machine/include/imx6ul-common.inc

SOC_FAMILY = "mx6ul"

PREFERRED_PROVIDER_u-boot = "u-boot-edm"
PREFERRED_PROVIDER_u-boot_mx6 = "u-boot-edm"
PREFERRED_PROVIDER_virtual/bootloader = "u-boot-edm"
PREFERRED_PROVIDER_virtual/bootloader_mx6 = "u-boot-edm"

UBOOT_MAKE_TARGET = ""
UBOOT_MACHINE = "pico-imx6ul-nand_defconfig"

# UBIFS configuration for NAND 512MB
UBI_VOLNAME  = "rootfs"
MKUBIFS_ARGS = " -m 2048 -e 124KiB -c 3965 "
UBINIZE_ARGS = " -m 2048 -p 128KiB -s 2048 -O 2048 "

IMAGE_FSTYPES_mx6ul += "ubi"

PREFERRED_PROVIDER_virtual/kernel ?= "linux-tn-imx"
PREFERRED_PROVIDER_virtual/kernel_mx6ul = "linux-tn-imx"

KERNEL_DEVICETREE = "imx6ul-pico-nand_hobbit.dtb"

KERNEL_IMAGETYPE = "zImage"

MACHINE_FEATURES += "bluetooth pci wifi touchscreen"

MACHINE_EXTRA_RRECOMMENDS += " \
  firmware-bcmdhd \
  broadcom-bluetooth \
  openssh-sftp-server \
  libsocketcan \
  bash hostapd dnsmasq haveged create-ap iptables ntp \
"

SERIAL_CONSOLE = "115200 ttymxc3"
```

## conf/machine/pico-imx6ul.conf
```bitbake
#@TYPE: Machine
#@NAME: PICO-IMX6UL
#@SOC: i.MX6UL/ULL
#@DESCRIPTION: Machine configuration for PICO-IMX6 with QCA(Qualcomm)/BRCM(Broadcom) WLAN module
#@MAINTAINER:	Andy Lin <andy.lin@technecion.com>		

MACHINEOVERRIDES =. "mx6:mx6ul:mx6ull:"
MACHINEOVERRIDES_EXTENDER_pico-imx6ul = "uenv"

include conf/machine/include/imx-base.inc
include conf/machine/include/tune-cortexa7.inc
require conf/machine/tn-base.inc

# Kernel Device Trees
KERNEL_DEVICETREE = "imx6ul-pico_pi.dtb	imx6ul-pico-qca_pi.dtb imx6ull-pico_pi.dtb imx6ull-pico-qca_pi.dtb"

# Bootloader Specifics
UBOOT_MACHINE = "pico-imx6ul_spl_defconfig"
SPL_BINARY_pico-imx6ul = "SPL"
UBOOT_SUFFIX_pico-imx6ul = "img"
UBOOT_MAKE_TARGET_pico-imx6ul = ""

# Peripherals
# Set Serial console
SERIAL_CONSOLE = "115200;ttymxc5"
SERIAL_BLUETOOTH = "3000000;ttymxc1"
```
