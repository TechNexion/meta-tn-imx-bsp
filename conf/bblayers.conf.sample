## conf/bblayers.conf.sample
```bitbake
# POKY_BBLAYERS_CONF_VERSION is increased each time build/conf/bblayers.conf
# changes incompatibly
POKY_BBLAYERS_CONF_VERSION = "2"

BBPATH = "${TOPDIR}"
BBFILES ?= ""

BBLAYERS ?= " \
  ##OEROOT##/meta \
  ##OEROOT##/meta-poky \
  \
  ##OEROOT##/../meta-openembedded/meta-oe \
  ##OEROOT##/../meta-openembedded/meta-multimedia \
  \
  ##OEROOT##/../meta-freescale \
  ##OEROOT##/../meta-freescale-3rdparty \
  ##OEROOT##/../meta-freescale-distro \
  \
  ##OEROOT##/../meta-edm-bsp-release \
  \
  ##OEROOT##/../meta-fsl-bsp-release/imx/meta-bsp \
  ##OEROOT##/../meta-fsl-bsp-release/imx/meta-sdk \
  ##OEROOT##/../meta-browser \
  ##OEROOT##/../meta-openembedded/meta-gnome \
  ##OEROOT##/../meta-openembedded/meta-networking \
  ##OEROOT##/../meta-openembedded/meta-python \
  ##OEROOT##/../meta-openembedded/meta-filesystems \
  ##OEROOT##/../meta-qt5 \
"
```

## conf/layer.conf
```bitbake
# We have a conf and classes directory, add to BBPATH
BBPATH .= ":${LAYERDIR}"

# We have recipes-* directories, add to BBFILES
BBFILES += "${LAYERDIR}/recipes-*/*/*.bb \
            ${LAYERDIR}/recipes-*/*/*.bbappend"

BBFILE_COLLECTIONS += "meta-edm-bsp-release"
BBFILE_PATTERN_meta-edm-bsp-release = "^${LAYERDIR}/"
BBFILE_PRIORITY_meta-edm-bsp-release = "9"
LAYERSERIES_COMPAT_meta-edm-bsp-release = "sumo"
```

## conf/machine/axon-imx6.conf
```bitbake
#@TYPE: Machine
#@NAME: AXON-IMX6
#@SOC: i.MX6Quad/DualLite/Solo
#@DESCRIPTION: Machine configuration for AXON-IMX6
#@MAINTAINER: Po Cheng <po.cheng@technexion.com>

MACHINEOVERRIDES =. "mx6:mx6dl:mx6q:"

include conf/machine/include/imx-base.inc
include conf/machine/include/tune-cortexa9.inc

MACHINE_SOCARCH_FILTER_append_mx6 = "virtual/libopenvg virtual/libgles1 virtual/libgles2 virtual/egl virtual/mesa virtual/libgl virtual/libg2d"

#
# Kernel Specifics
#
PREFERRED_PROVIDER_virtual/kernel ?= "linux-tn-imx"
PREFERRED_PROVIDER_virtual/kernel_mx6 = "linux-tn-imx"

# Add kernel modules
MACHINE_EXTRA_RRECOMMENDS += "\
    kernel-module-qcacld-tn \
"

KERNEL_DEVICETREE ?= " \
	imx6dl-axon-pi.dtb \
	imx6q-axon-pi.dtb \
"

KERNEL_IMAGETYPE = "zImage"

#
# Bootloader Specifics
#
PREFERRED_PROVIDER_u-boot = "u-boot-edm"
PREFERRED_PROVIDER_u-boot_mx6 = "u-boot-edm"
PREFERRED_PROVIDER_virtual/bootloader = "u-boot-edm"
PREFERRED_PROVIDER_virtual/bootloader_mx6 = "u-boot-edm"

UBOOT_MAKE_TARGET = ""
UBOOT_SUFFIX = "img"
SPL_BINARY = "SPL"
UBOOT_MACHINE = "axon-imx6_defconfig"

# Ensure uEnv.txt will be available at rootfs time
do_rootfs[depends] += "u-boot-uenv:do_deploy"

UENV_FILENAME = "uEnv.txt"
BOOT_SCRIPTS = "${UENV_FILENAME}:uEnv.txt"

#
# Extra Stuff
#
MACHINE_FEATURES += "bluetooth pci wifi touchscreen"

BOOT_SPACE = "32768"

MACHINE_EXTRA_RRECOMMENDS += " \
  linux-firmware-qca-tn \
  openssh-sftp-server \
  libsocketcan \
  bash hostapd dnsmasq haveged iptables create-ap \
  iperf3 \
  afloader axonfabric-firmware \
"

MACHINE_FIRMWARE_remove ?= "firmware-imx-brcm"

#
# Peripherals
#
# Set Serial console
SERIAL_CONSOLE = "115200 ttymxc0"
```

## conf/machine/axon-imx8mm.conf
```bitbake
#@TYPE: Machine
#@NAME: AXON-IMX8M
#@SOC: i.MX8MM
#@DESCRIPTION: Machine configuration for TechNexion AXON-IMX8MM
#@MAINTAINER: Richard Hu <richard.hu@technexion.com>

MACHINEOVERRIDES =. "mx8:mx8m:mx8mm:"

require conf/machine/include/imx-base.inc
require conf/machine/include/arm/arch-arm64.inc
require conf/machine/tn-base.inc

# Kernel specifics
KERNEL_DEVICETREE ?= " \
	freescale/imx8mm-axon-pi.dtb \
	freescale/imx8mm-axon-pi-ili9881c.dtb \
	freescale/imx8mm-axon-pi-ov7251.dtb \
	freescale/imx8mm-axon-pi-voicehat.dtb \
	freescale/imx8mm-axon-loopbacktest.dtb \
	freescale/imx8mm-axon-wizard.dtb \
	freescale/imx8mm-axon-wizard-ov7251.dtb	\
	freescale/imx8mm-axon-wizard-adv7535.dtb \
	freescale/imx8mm-axon-wizard-ili9881c.dtb \
	freescale/imx8mm-axon-wizard-voicehat.dtb \
	freescale/imx8mm-axon-wizard-g080uan01.dtb \
	freescale/imx8mm-axon-wizard-g101uan02.dtb \
	freescale/imx8mm-axon-wizard-sn65dsi84-m101nwwb.dtb \
	freescale/imx8mm-axon-wizard-sn65dsi84-g156xw01.dtb \
	freescale/imx8mm-axon-wizard-sn65dsi84-g215hvn01.dtb \
"

# U-boot specifics
UBOOT_CONFIG[sd] = "axon-imx8mm_defconfig,sdcard"
UBOOT_CONFIG[mfgtool] = "axon-imx8mm_defconfig"
UBOOT_DTB_NAME = "imx8mm-axon-pi.dtb"

# Set Serial console
SERIAL_CONSOLE = "115200;ttymxc0"
SERIAL_BLUETOOTH = "3000000;ttymxc3"

BOOT_SPACE = "65536"

# WIC Image
#WKS_FILE_virtualization = "tn-imx8-imxboot-rootfs-container.wks.in"
WIC_FSTAB_BLKDEV = "mmcblk2"
#WIC_CREATE_EXTRA_ARGS = "--no-fstab-update"
WIC_PARTITION_TABLE_TYPE ?= "msdos"
#IMAGE_FSTYPES_append_virtualization = " wic wic.xz wic.md5sum"
#IMAGE_FSTYPES_remove_virtualization = " sdcard sdcard.bz2 sdcard.xz sdcard.md5sum"
#IMAGE_BOOT_FILES = "\
#    ${KERNEL_IMAGETYPE} \
#    imx8mm-pico*.dtb* \
#    ${IMAGE_BOOTFILES} \
#"

# technexion software-loader - UBOOT entry address for fitImages
UBOOT_ENTRYPOINT_rescue = "0x40480000"
#UBOOT_RD_ENTRYPOINT_rescue = "0x43800000"
#UBOOT_RD_LOADADDRESS_rescue = "0x43800000"
UBOOT_FDT_LOADADDRESS_rescue = "0x40440000"
UBOOT_FDTOV_LOADADDRESS_rescue = "0x40430000"

# Other stuff
MACHINE_EXTRA_RRECOMMENDS += " \
  afloader axonfabric-firmware \
"
LICENSE_FLAGS_WHITELIST += "commercial_tn"
```

## conf/machine/edm-fairy-imx6.conf
```bitbake
#@TYPE: Machine
#@NAME: EDM Fairy i.mx6
#@SOC: i.MX6Q
#@DESCRIPTION: Machine configuration for EDM Fairy i.mx6

include conf/machine/include/imx-base.inc
include conf/machine/include/tune-cortexa9.inc

SOC_FAMILY = "mx6:mx6dl:mx6q"

PREFERRED_PROVIDER_u-boot = "u-boot-edm"
PREFERRED_PROVIDER_virtual/bootloader = "u-boot-edm"
PREFERRED_PROVIDER_u-boot_mx6 = "u-boot-edm"
UBOOT_MAKE_TARGET = ""
UBOOT_SUFFIX = "img"
SPL_BINARY = "SPL"
UBOOT_MACHINE = "edm-cf-imx6_defconfig"

PREFERRED_PROVIDER_virtual/kernel ?= "linux-edm-fairy"
PREFERRED_PROVIDER_virtual/kernel_mx6 = "linux-edm-fairy"

KERNEL_DEVICETREE = "imx6q-edm1-cf.dtb \
                     imx6dl-edm1-cf.dtb"
KERNEL_IMAGETYPE = "zImage"

MACHINE_FEATURES += "bluetooth pci wifi touchscreen"

MACHINE_EXTRA_RRECOMMENDS += " \
  bcm4330-nvram-config \
"

SERIAL_CONSOLE = "115200 ttymxc0"
```

## conf/machine/edm-goblin-imx6sx.conf
```bitbake
#@TYPE: Machine
#@NAME: EDM Goblin i.mx6SX
#@SOC: i.MX6SX
#@DESCRIPTION: Machine configuration for EDM Goblin i.mx6SX

require conf/machine/include/imx-base.inc
require conf/machine/include/tune-cortexa9.inc

SOC_FAMILY = "mx6:mx6sx"

PREFERRED_PROVIDER_u-boot = "u-boot-edm"
PREFERRED_PROVIDER_virtual/bootloader = "u-boot-edm"
PREFERRED_PROVIDER_u-boot_mx6 = "u-boot-edm"
UBOOT_MAKE_TARGET = ""
UBOOT_SUFFIX = "img"
SPL_BINARY = "SPL"
UBOOT_MACHINE = "edm1-cf-imx6sx_spl_defconfig"

PREFERRED_PROVIDER_virtual/kernel ?= "linux-edm-goblin-imx6sx"
PREFERRED_PROVIDER_virtual/kernel_mx6 = "linux-edm-goblin-imx6sx"

KERNEL_DEVICETREE = "imx6sx-edm1-cf.dtb imx6sx-edm1-cf-m4.dtb"
KERNEL_IMAGETYPE = "zImage"

MACHINE_FEATURES += "bluetooth pci wifi touchscreen"

MACHINE_EXTRA_RRECOMMENDS += " \
  bcm4330-nvram-config \
  broadcom-bluetooth \
  openssh-sftp-server \
  libsocketcan \
"
SERIAL_CONSOLE = "115200 ttymxc0"
```

## conf/machine/edm-imx6.conf
```bitbake
#@TYPE: Machine
#@NAME: edm-imx6
#@SOC: i.MX6Q/Dual/DualLite/Solo/QuadPlus
#@DESCRIPTION: Machine configuration for EDM-IMX6 with QCA(Qualcomm)/BRCM(Broadcom) WLAN module 

MACHINEOVERRIDES =. "mx6:mx6dl:mx6q:"

include conf/machine/include/imx-base.inc
include conf/machine/include/tune-cortexa9.inc

BBMASK += "\
  meta-fsl-bsp-release/imx/meta-sdk/recipes-fsl/packagegroup/packagegroup-fsl-optee-imx.bb \
  meta-fsl-bsp-release/imx/meta-bsp/recipes-security/optee-imx/optee-os-imx_git.bb \
"

#
# Bootloader Specifics
#
PREFERRED_PROVIDER_u-boot = "u-boot-edm"
PREFERRED_PROVIDER_u-boot_mx6 = "u-boot-edm"
PREFERRED_PROVIDER_virtual/bootloader = "u-boot-edm"
PREFERRED_PROVIDER_virtual/bootloader_mx6 = "u-boot-edm"

UBOOT_MAKE_TARGET = ""
UBOOT_SUFFIX = "img"
SPL_BINARY = "SPL"
UBOOT_MACHINE = "edm-cf-imx6_spl_defconfig"

# Ensure uEnv.txt will be available at rootfs time
do_rootfs[depends] += "u-boot-uenv:do_deploy"

UENV_FILENAME = "uEnv.txt"
BOOT_SCRIPTS = "${UENV_FILENAME}:uEnv.txt"

#
# Kernel Specifics
#
PREFERRED_PROVIDER_virtual/kernel ?= "linux-tn-imx"
PREFERRED_PROVIDER_virtual/kernel_mx6 = "linux-tn-imx"

KERNEL_DEVICETREE ?= "imx6dl-edm1_fairy.dtb imx6q-edm1_fairy.dtb imx6qp-edm1_fairy.dtb \
                      imx6dl-edm1-qca_fairy.dtb imx6q-edm1-qca_fairy.dtb imx6qp-edm1-qca_fairy.dtb \
                      imx6dl-edm1_gnome.dtb imx6q-edm1_gnome.dtb imx6qp-edm1_gnome.dtb \
                      imx6dl-edm1-qca_gnome.dtb imx6q-edm1-qca_gnome.dtb imx6qp-edm1-qca_gnome.dtb \
                      imx6dl-edm1_tc0700.dtb imx6q-edm1_tc0700.dtb imx6qp-edm1_tc0700.dtb \
                      imx6dl-edm1-qca_tc0700.dtb imx6q-edm1-qca_tc0700.dtb imx6qp-edm1-qca_tc0700.dtb \
                      imx6dl-edm1_tc1000.dtb imx6q-edm1_tc1000.dtb imx6qp-edm1_tc1000.dtb \
                      imx6dl-edm1-qca_tc1000.dtb imx6q-edm1-qca_tc1000.dtb imx6qp-edm1-qca_tc1000.dtb"

KERNEL_IMAGETYPE = "zImage"

#
# Extra Stuff
#
MACHINE_FEATURES += "bluetooth pci wifi touchscreen"

MACHINE_EXTRA_RRECOMMENDS += " \
  broadcom-bluetooth \
  openssh-sftp-server \
  libsocketcan \
  bash hostapd dnsmasq haveged create-ap iptables \
"

IMAGE_INSTALL_append_edm-imx6 = " packagegroup-tn-wlan"

#
# Peripherals
#
# Set Serial console
SERIAL_CONSOLE = "115200;ttymxc0"

IMAGE_CLASSES += "image_types_fsl_tn"
IMAGE_CLASSES_remove = "image_types_fsl"
HOSTTOOLS_NONFATAL += "git-lfs"
LICENSE_FLAGS_WHITELIST += "commercial_qca commercial_brcm"
```

## conf/machine/edm-imx8mq.conf
```bitbake
#@TYPE: Machine
#@NAME: EDM-IMX8M
#@SOC: i.MX8MQ
#@DESCRIPTION: Machine configuration for EDM-IMX8MQ
#@MAINTAINER: Richard Hu <richard.hu@technexion.com>

MACHINEOVERRIDES =. "mx8:mx8m:mx8mq:"

require conf/machine/include/imx-base.inc
require conf/machine/include/arm/arch-arm64.inc
require conf/machine/tn-base.inc

# Kernel Device Trees
KERNEL_DEVICETREE = "freescale/imx8mq-edm-wizard.dtb \
                     freescale/imx8mq-edm-fairy.dtb \
"
# Setup the additional devicetree file
KERNE_DEVICERTEE_append_voicehat = " freescale/imx8mq-edm-wizard-voicehat.dtb"

#IMAGE_M4LOADER = "imx-m4-demos"
#IMAGE_M4 = "imx8mq_m4_TCM_hello_world.bin imx8mq_m4_TCM_rpmsg_lite_pingpong_rtos_linux_remote.bin imx8mq_m4_TCM_rpmsg_lite_str_echo_rtos.bin"

# Bootloader Specifics
UBOOT_CONFIG[sd] = "edm-imx8mq_defconfig,sdcard"
UBOOT_CONFIG[mfgtool] = "edm-imx8mq_defconfig"

# Set u-boot DTB
UBOOT_DTB_NAME = "imx8mq-edm-wizard.dtb"

# Peripherals
# Set Serial console
SERIAL_CONSOLES = "115200;ttymxc0"
SERIAL_BLUETOOTH = "3000000;ttymxc1"

# WIC Image
#WIC_FSTAB_BLKDEV = "mmcblk0"
#WIC_CREATE_EXTRA_ARGS = "--no-fstab-update"
#IMAGE_FSTYPES_append = " wic"
#IMAGE_BOOT_FILES = "\
#    ${KERNEL_IMAGETYPE} \
#    imx8mq-edm*.dtb \
#    ${IMAGE_BOOTFILES} \
#"
```

## conf/machine/edm-imx93.conf
```bitbake
#@TYPE: Machine
#@NAME: TechNexion EDM-IMX93
#@SOC: NXP i.MX93
#@DESCRIPTION: Machine configuration for TechNexion i.MX 93 EDM board
#@MAINTAINER: Alex Fang <alex.fang@technexion.com>

MACHINEOVERRIDES =. "mx93:"

require conf/machine/include/imx-base.inc
require conf/machine/include/arm/armv8-2a/tune-cortexa55.inc
require conf/machine/tn-base.inc

# Kernel specifics
KERNEL_DEVICETREE = " \
		freescale/imx93-edm-wb.dtb \
		freescale/overlays/imx93-edm-wb-lvds-vl10112880.dtbo \
		freescale/overlays/imx93-edm-wb-lvds-vl15613676.dtbo \
		freescale/overlays/imx93-edm-wb-vxt-vl050-070-8048nt.dtbo \
		freescale/overlays/imx93-edm-wb-vxt-vl0808060nt.dtbo \
		freescale/overlays/imx93-edm-wb-tevs.dtbo \
		freescale/overlays/imx93-edm-wb-vls.dtbo \
"
EXTRA_OEMAKE:append:pn-linux-tn-imx = " DTC_FLAGS='-@ -H epapr'"

# U-boot specifics
UBOOT_CONFIG = "sd"
UBOOT_CONFIG[sd] = "edm-imx93_defconfig,sdcard"
UBOOT_CONFIG[mfgtool] = "edm-imx93_defconfig"
UBOOT_DTB_NAME = "imx93-edm.dtb"

# Set ATF platform name
ATF_PLATFORM = "imx93"
IMXBOOT_TARGETS = "flash_singleboot"
IMX_BOOT_SOC_TARGET = "iMX9"
IMX_BOOT_SEEK:edm-imx93 = "32"

# Set Serial console
SERIAL_CONSOLES = "115200;ttyLP0"
SERIAL_BLUETOOTH = "3000000;ttyLP4"

DDR_FIRMWARE_NAME = " \
    lpddr4_dmem_1d_v202201.bin \
    lpddr4_dmem_2d_v202201.bin \
    lpddr4_imem_1d_v202201.bin \
    lpddr4_imem_2d_v202201.bin \
"
IMX_DEFAULT_BOOTLOADER:use-nxp-bsp = "u-boot-imx"
IMX_DEFAULT_BOOTLOADER:use-mainline-bsp = "u-boot-fslc"

# WIC Image
M33_MACHINE = "edm-imx93"
WKS_FILE_DEPENDS:append = " imx-m33-demos-tn"
IMAGE_BOOTFILES += "sdk20-app.bin \
		    rpmsg_lite_pingpong_rtos_linux_remote.bin \
		    rpmsg_lite_str_echo_rtos.bin \
"
WIC_FSTAB_BLKDEV = "mmcblk0"
WIC_PARTITION_TABLE_TYPE ?= "msdos"
IMAGE_BOOT_FILES += "\
    ${IMAGE_BOOTFILES} \
"
```

## conf/machine/edm-imx95-16gb.conf
```bitbake
#@TYPE: Machine
#@NAME: TechNexion EDM-IMX95
#@SOC: i.MX95
#@DESCRIPTION: Machine configuration for TechNexion EDM-IMX95
#@MAINTAINER: Richard Hu <richard.hu@technexion.com>

require edm-imx95.conf
OEI_DDR_CONFIG = "lpddr5_6400mbps_train_timing_16gb"
PACKAGECONFIG:append:pn-imx-oei = " tcm"
```

## conf/machine/edm-imx95-4gb.conf
```bitbake
#@TYPE: Machine
#@NAME: TechNexion EDM-IMX95
#@SOC: i.MX95
#@DESCRIPTION: Machine configuration for TechNexion EDM-IMX95
#@MAINTAINER: Richard Hu <richard.hu@technexion.com>

require edm-imx95.conf
OEI_DDRCONFIG = "lpddr5_6400mbps_train_timing_4gb"
```
